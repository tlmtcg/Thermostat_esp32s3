## components/dht/Kconfig.dht
```kconfig
menu "Sensor DHT"

    config BIT_SHT31_EN
        bool "Enable DHT"
        default y
    endmenu
```

## components/sht31/KConfig.sht31
```kconfig
menu "Sensor SHT31"

    config BIT_DHT_EN
        bool "Enable SHT31"
        default y
    endmenu
```

## main/Kconfig.projbuild
```kconfig
menu "Configuration Thermostat"

    menu "Réseau et Cloud"
    rsource "../components/email_service/Kconfig.email"
    rsource "../components/freebox_ftp/Kconfig.ftp"
    rsource "../components/jeedom/Kconfig.jeedom"
    rsource "../components/time_utils/Kconfig.time"
    rsource "../components/wifi/Kconfig.wifi"
    endmenu

    menu "Matériel et Capteurs"
    rsource "../components/led_ctrl/Kconfig.led"
    rsource "../components/relay/Kconfig.relay"
    rsource "../components/sd_card/Kconfig.sd"
    rsource "../components/i2c_manager/Kconfig.i2c"
    rsource "../components/config_storage/Kconfig.storage"
    rsource "../components/sht31/Kconfig.sht31"
    rsource "../components/dht/Kconfig.dht"
    endmenu
    
    menu "Expert"
    rsource "../components/alert_manager/Kconfig.alert"
    rsource "../components/serial_manager/Kconfig.serial"
    rsource "../components/tasks/Kconfig.task"
    endmenu

endmenu
```
