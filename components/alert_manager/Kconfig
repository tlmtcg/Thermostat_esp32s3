## components/alert_manager/Kconfig
```kconfig
menu "Alerts Configuration"

config MAX_ALERT_LOGS
    int "MAX ALERT LOGS"
    default 10
    help
        Max number of alert logs.

config MAX_ACTIVE_ALERTS
    int "MAX ACTIVE ALERTS"
    default 5
    help
        Max number of active alerts.
    
endmenu
```

## components/alert_manager/Kconfig.alert
```kconfig
menu "Alerts Configuration"

    config MAX_ALERT_LOGS
        int "MAX ALERT LOGS"
        default 10
        help
            Max number of alert logs.

    config MAX_ACTIVE_ALERTS
        int "MAX ACTIVE ALERTS"
        default 5
        help
            Max number of active alerts.

    config MAX_HISTORY_ALERTS
        int "MAX HISTORY ALERTS"
        default 50
        help
            Max number of historical alerts to keep.
            
    endmenu
```

## components/config_storage/Kconfig.storage
```kconfig
menu "Configuration Storage"

config CONFIG_STORAGE_FILENAME
    string "Nom du fichier de configuration"
    default "config.json"

config CONFIG_STORAGE_ENABLE
    bool "Activer la sauvegarde automatique de la configuration"
    default y

endmenu
```

## components/email_service/Kconfig.email
```kconfig
 menu "Email Configuration"

    config SMTP_USER
        string "User"
        default "dup.cordon@gmail.com"

    config SMTP_PASS
        string "Password"
        default "sxul btjb alns gpzk"

    config SMTP_RCPT_TO
        string "Send To"
        default "dup.cordon@gmail.com"


endmenu
```

## components/freebox_ftp/Kconfig
```kconfig
menu "Freebox FTP Configuration"

    config FREEBOX_FTP_USER
        string "FTP Username"
        default "freebox"

    config FREEBOX_FTP_PASSWORD
        string "FTP Password"
        default "Tr2s_76142505"

endmenu
```

## components/freebox_ftp/Kconfig.ftp
```kconfig
menu "Freebox FTP Configuration"

        config FB_FTP_HOST
            string "IP de la Freebox"
            default "192.168.0.254"
            help
                L'adresse IP locale de votre Freebox.

        config FREEBOX_FTP_USER
            string "FTP Username"
            default "freebox"

        config FREEBOX_FTP_PASS
            string "FTP Password"
            default "Tr2s_76142505"

        config FB_FTP_PORT
            int "Port FTP"
            default 21
            help
                Le port standard est 21.

        config FB_FTP_PATH
            string "Dossier cible"
            default "Freebox/Logs"
            help
                Le dossier sur la Freebox où les fichiers seront stockés.

        config BIT_FTP_SYNC_EN
            bool "Enable Freebox FTP History Sync Task"
            default y
            help
                Permet d'activer ou de désactiver la tâche de synchronisation de l'historique des températures vers la Freebox au démarrage.


    endmenu
```

## components/i2c_manager/Kconfig.i2c
```kconfig
menu "I2C Manager Configuration"

config I2C_MANAGER_SDA
    int "I2C SDA GPIO"
    default 8
    help
        GPIO utilisé pour SDA du bus I2C

config I2C_MANAGER_SCL
    int "I2C SCL GPIO"
    default 9
    help
        GPIO utilisé pour SCL du bus I2C

config I2C_MANAGER_FREQ
    int "Fréquence du bus I2C (Hz)"
    default 400000
    help
        Fréquence du bus I2C en Hertz (100k, 400k, etc.)

endmenu
```

## components/jeedom/Kconfig.jeedom
```kconfig
 menu "Jeedom Configuration"

    config API_KEY
        string "API KEY"
        default "Your Jeedom API Key"
        help
            Your API key.

    config JEEDOM_ENABLE
        bool "Enable Jeedom Integration"
        default false
        help
            Enable Jeedom Integration.

    config JEEDOM_HOST
        string "Jeedom Host"
        default "http://jeedom.local"
        help
            Jeedom Host URL.

    config JEEDOM_PORT
        int "Jeedom Port"
        default 80
        help
            Jeedom Port.

    config JEEDOM_PATH
        string "Jeedom Path"
        default "/core/api/jeeApi.php"
        help
            Jeedom API Path.
        
    endmenu
```

## components/led_ctrl/Kconfig
```kconfig
menu "LED Control Configuration"

    config LED_STRIP_GPIO
        int "GPIO number for the RGB LED"
        range 0 48
        default 48
        help
            The GPIO pin connected to the WS2812/NeoPixel LED.

    config LED_STRIP_BRIGHTNESS
        int "Maximum LED Brightness (0-255)"
        range 0 255
        default 50

    config LED_ALARM_COLOR_RED
        int "Alarm Red Intensity"
        range 0 255
        default 255

    config LED_ALARM_BLINK_SPEED_MS
        int "Alarm Blink Speed (ms)"
        default 200

endmenu
```

## components/led_ctrl/Kconfig.led
```kconfig
menu "LED Control Configuration"

    config LED_STRIP_GPIO
            int "GPIO number for the RGB LED"
            range 0 48
            default 48
            help
                The GPIO pin connected to the WS2812/NeoPixel LED. 
                Default is 48 on most ESP32-S3 DevKits.

        config LED_STRIP_BRIGHTNESS
            int "Maximum LED Brightness (0-255)"
            range 0 255
            default 50
            help
                Global brightness limit to prevent eye strain and high current draw.
                A value of 50 is usually sufficient for indoor use.

        config LED_ALARM_COLOR_RED
            int "Alarm Red Intensity"
            range 0 255
            default 255
            help
                Red component intensity during alarm blinks.

        config LED_ALARM_BLINK_SPEED_MS
            int "Alarm Blink Speed (ms)"
            default 200
            help
                Duration of the 'on' and 'off' phases during an alarm blink.

    endmenu
```

## components/relay/Kconfig.relay
```kconfig
menu "Relais Configuration"

    config RELAY_GPIO_PIN
        int "Relay GPIO Pin"
        range 0 48
        default 18
        help
            Le numero du GPIO sur lequel est branche le relais de commande de la chaudiere.

    config RELAY_INVERTED
        bool "Inverser la logique du relais"
        default n
        help
            Cochez si le relais s'active avec un niveau BAS (0V).

    config RELAY_MIN_DELAY_SEC
        int "Delai minimum entre commutations (secondes)"
        range 0 3600
        default 60
        help
            Empeche le relais de changer d'etat trop rapidement pour proteger la chaudiere.

    endmenu
```

## components/sd_card/Kconfig.sd
```kconfig
menu "SD Card Configuration"

    config SD_CARD_ENABLED
        bool "Enable SD Card Component"
        default y
        help
            Désactivez cette option pour ne pas compiler le support SD.

    config SD_CARD_MOSI_GPIO
        int "MOSI GPIO Pin"
        default 2
        range 0 48

    config SD_CARD_MISO_GPIO
        int "MISO GPIO Pin"
        default 5
        range 0 48

    config SD_CARD_SCLK_GPIO
        int "SCLK GPIO Pin"
        default 4
        range 0 48

    config SD_CARD_CS_GPIO
        int "CS GPIO Pin"
        default 1
        range 0 48

    config SD_CARD_FORMAT_IF_FAILED
        bool "Format card if mount fails"
        default y
        help
            Formate automatiquement la carte en FAT32 si elle est illisible.

    endmenu
    
```

## components/tasks/Kconfig.task
```kconfig
menu "Tasks Configuration"

    menu "Weather Task"
    config BIT_WEATHER_EN
        bool "Enable Weather Task"
        default y

    config WEATHER_DELAY_MS
        int "Weather task delay (ms)"
        default 900000
        range 0 3600000
    endmenu

    menu "Jeedom Task"
    config BIT_JEEDOM_EN
        bool "Enable Jeedom Task"
        default y

    config JEEDOM_DELAY_MS
        int "Jeedom task delay (ms)"
        default 60000
        range 0 3600000
    endmenu

    menu "NTP Task"
    config BIT_NTP_EN
        bool "Enable NTP Task"
        default y

    config NTP_DELAY_MS
        int "NTP task delay (ms)"
        default 60000
        range 0 3600000
    endmenu

    menu "LED Task"
    config BIT_LED_EN
        bool "Enable LED Task"
        default y

    config LED_DELAY_MS
        int
        default 0
    endmenu

    menu "Storage Task"
    config BIT_STORAGE_EN
        bool
        default y

    config STORAGE_DELAY_MS
        int
        default 0
    endmenu

    menu "Serial Task"
    config BIT_SERIAL_EN
        bool "Enable Serial Task"
        default y

    config SERIAL_DELAY_MS
        int
        default 0

    endmenu

endmenu
```

## components/web_server/wifi/Kconfig
```kconfig
menu "WiFi Manager Configuration"

config ESP_WIFI_RETRY_INTERVAL_MS
    int "Retry interval (ms)"
    default 5000

config ESP_WIFI_STA_SSID
    string "Station SSID"
    default "myssid"

config ESP_WIFI_STA_PASSWORD
    string "Station password"
    default "mypassword"

config ESP_WIFI_AP_SSID
    string "AP SSID"
    default "esp32_ap"

config ESP_WIFI_AP_PASSWORD
    string "AP password"
    default "12345678"

config ESP_WIFI_AP_CHANNEL
    int "AP channel"
    default 1

config ESP_MAX_STA_CONN_AP
    int "Max STA connections"
    default 4

endmenu
```
